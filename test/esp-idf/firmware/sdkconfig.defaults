## test/esp-idf/firmware/sdkconfig.defaults
```kconfig
#
# Flash: partitions.csv requires ~4MB (dual OTA + spiffs)
#
CONFIG_ESPTOOLPY_FLASHSIZE_4MB=y
CONFIG_ESPTOOLPY_FLASHSIZE="4MB"

#
# TRACKLE OTA
#
CONFIG_OTA_ALLOW_HTTP=y
CONFIG_ESP_TLS_INSECURE=y
CONFIG_ESP_TLS_SKIP_SERVER_CERT_VERIFY=y

#
# TRACKLE OPTIMIZATION
#
CONFIG_ESP_MAIN_TASK_STACK_SIZE=8192
CONFIG_TIMER_TASK_STACK_DEPTH=2048
CONFIG_LWIP_UDP_RECVMBOX_SIZE=64
CONFIG_COMPILER_OPTIMIZATION_SIZE=y
CONFIG_COMPILER_OPTIMIZATION_ASSERTIONS_SILENT=y
CONFIG_COMPILER_STACK_CHECK_MODE_NORM=y
CONFIG_COMPILER_STACK_CHECK=y

#
# TRACKLE MBEDTLS
#
CONFIG_MBEDTLS_ECP_C=y
CONFIG_MBEDTLS_ECP_DP_SECP256R1_ENABLED=y
CONFIG_MBEDTLS_ECP_DP_SECP384R1_ENABLED=y
CONFIG_MBEDTLS_ECP_DP_CURVE25519_ENABLED=y

#
# Bluetooth (required by trackle_utils_bt_*)
#
CONFIG_BT_ENABLED=y
CONFIG_BT_NIMBLE_ENABLED=y
CONFIG_BT_CONTROLLER_ENABLED=y
CONFIG_BT_NIMBLE_HOST_TASK_STACK_SIZE=4096

#
# Network Provisioning Manager
#
CONFIG_NETWORK_PROV_BLE_FORCE_ENCRYPTION=n
CONFIG_ESP_PROTOCOMM_SUPPORT_SECURITY_VERSION_1=y
```
