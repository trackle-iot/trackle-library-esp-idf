## sdkconfig.defaults
```kconfig
#
# TRACKLE OTA
#
CONFIG_OTA_ALLOW_HTTP=n
CONFIG_ESP_TLS_INSECURE=y
CONFIG_ESP_TLS_SKIP_SERVER_CERT_VERIFY=y

#
# TRACKLE OPTIMIZATION
#
CONFIG_ESP_MAIN_TASK_STACK_SIZE=4096
CONFIG_TIMER_TASK_STACK_DEPTH=2048
CONFIG_LWIP_UDP_RECVMBOX_SIZE=64
CONFIG_COMPILER_OPTIMIZATION_SIZE=y
CONFIG_COMPILER_OPTIMIZATION_ASSERTIONS_SILENT=y
CONFIG_COMPILER_STACK_CHECK_MODE_NORM=y
CONFIG_COMPILER_STACK_CHECK=y

#
# TRACKLE MBEDTLS
#
CONFIG_MBEDTLS_ECP_C=y
CONFIG_MBEDTLS_ECP_DP_SECP256R1_ENABLED=y
CONFIG_MBEDTLS_ECP_DP_SECP384R1_ENABLED=y #for new 384bit LetsEncrypt certificates
```
